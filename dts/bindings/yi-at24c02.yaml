## dts/bindings/yi-at24c02.yaml
```yaml
compatible: "atmel,24c02"
driver: "at24c02"
header: "yi_at24c02.h"
define: "YI_AT24C02_DEFINE_LEVEL"

properties:
  bus:
    type: phandle
    required: true
  address:
    type: int
    default: 80
  size:
    type: int
    default: 256
  page-size:
    type: int
    default: 8
  transfer-timeout-ms:
    type: int
    default: 20
  write-timeout-ms:
    type: int
    default: 20
  init-level:
    type: string
    default: post-kernel
  init-priority:
    type: int
    default: 30
```

## dts/bindings/yi-can.yaml
```yaml
compatible: "yi,stm32-can"
driver: "can"
header: "yi_can_stm32f1.h"
define: "YI_CAN_DEFINE_LEVEL"

properties:
  reg:
    type: int
    required: true
  clock-bus:
    type: string
    required: true
  clock-enable-mask:
    type: int
    required: true
  tx-interrupt:
    type: identifier
    required: true
  rx0-interrupt:
    type: identifier
    required: true
  rx1-interrupt:
    type: identifier
    required: true
  sce-interrupt:
    type: identifier
    required: true
  tx-pin:
    type: phandle
    required: true
  rx-pin:
    type: phandle
    required: true
  bitrate:
    type: int
    required: true
  sample-point:
    type: int
    default: 875
  irq-priority:
    type: int
    default: 10
  init-level:
    type: string
    default: post-kernel
  init-priority:
    type: int
    default: 20
```

## dts/bindings/yi-clock.yaml
```yaml
compatible: "yi,stm32-clock"
driver: "clock"
header: "yi_clock_stm32f1.h"
define: "YI_CLOCK_DEFINE_LEVEL"

properties:
  clock-id:
    type: string
    required: true
  init-level:
    type: string
    default: pre-kernel
  init-priority:
    type: int
    default: 5
```

## dts/bindings/yi-console.yaml
```yaml
compatible: "yi,console"
driver: "console"
header: "yi_console.h"
define: "YI_CONSOLE_DEFINE_LEVEL"

properties:
  backend:
    type: phandle
    required: true
  default-console:
    type: boolean
  init-level:
    type: string
    default: application
  init-priority:
    type: int
    default: 0
```

## dts/bindings/yi-flash.yaml
```yaml
compatible: "yi,stm32-internal-flash"
driver: "flash"
header: "yi_flash.h"
define: "YI_STM32_FLASH_DEFINE_LEVEL"

properties:
  base-address:
    type: int
    required: true
  size:
    type: int
    required: true
  erase-block-size:
    type: int
    required: true
  write-block-size:
    type: int
    default: 2
  init-level:
    type: string
    default: pre-kernel
  init-priority:
    type: int
    default: 0
```

## dts/bindings/yi-gpio-led.yaml
```yaml
compatible: "yi,gpio-led"
driver: "led"
header: "yi_led.h"
define: "YI_LED_DEFINE_LEVEL"

properties:
  gpios:
    type: phandle
    required: true

  active-low:
    type: boolean
    required: false

  init-level:
    type: string
    required: false
    default: application

  init-priority:
    type: int
    required: false
    default: 50
```

## dts/bindings/yi-gpio.yaml
```yaml
compatible: "yi,stm32-gpio"
driver: "gpio"
header: "yi_gpio.h"
define: "YI_DEVICE_DEFINE_WITH_API"

properties:
  port:
    type: identifier
    required: true

  pin:
    type: int
    required: true

  clocks:
    type: phandle
    required: true

  direction:
    type: string
    default: output

  drive:
    type: string
    default: push-pull

  pull:
    type: string
    default: none

  interrupt:
    type: string
    default: none

  irq-priority:
    type: int
    default: 10

  init-level:
    type: string
    required: false
    default: pre-kernel

  init-priority:
    type: int
    required: false
    default: 50
```

## dts/bindings/yi-i2c.yaml
```yaml
compatible: "yi,stm32-i2c"
driver: "i2c"
header: "yi_i2c_stm32.h"
define: "YI_I2C_STM32_DEFINE_LEVEL"

properties:
  reg:
    type: int
    required: true
  clock-bus:
    type: string
    required: true
  clock-enable-mask:
    type: int
    required: true
  event-interrupt:
    type: identifier
    required: true
  error-interrupt:
    type: identifier
    required: true
  scl-pin:
    type: phandle
    required: true
  sda-pin:
    type: phandle
    required: true
  clock-frequency:
    type: int
    required: true
  irq-priority:
    type: int
    default: 10
  init-level:
    type: string
    default: post-kernel
  init-priority:
    type: int
    default: 20
```

## dts/bindings/yi-pinmux.yaml
```yaml
compatible: "yi,stm32-pinmux"
driver: "pinmux"
header: "yi_pinmux.h"
define: "YI_PINMUX_DEFINE_LEVEL"

properties:
  port:
    type: identifier
    required: true
  pin:
    type: int
    required: true
  function:
    type: string
    required: true
  mode:
    type: string
    required: true
  pull:
    type: string
    default: none
  speed:
    type: string
    default: low
  clocks:
    type: phandle
    required: true
  init-level:
    type: string
    default: pre-kernel
  init-priority:
    type: int
    default: 20
```

## dts/bindings/yi-rtt.yaml
```yaml
compatible: "yi,segger-rtt"
driver: "rtt"
header: "yi_rtt.h"
define: "YI_RTT_DEFINE_LEVEL"

properties:
  up-buffer:
    type: int
    default: 0
  mode:
    type: string
    default: no-block-skip
  init-level:
    type: string
    default: post-kernel
  init-priority:
    type: int
    default: 10
```

## dts/bindings/yi-soft-i2c.yaml
```yaml
compatible: "yi,soft-i2c"
driver: "soft-i2c"
header: "yi_soft_i2c.h"
define: "YI_SOFT_I2C_DEFINE_LEVEL"

properties:
  scl-gpio:
    type: phandle
    required: true
  sda-gpio:
    type: phandle
    required: true
  clock-frequency:
    type: int
    default: 50000
  stretch-timeout-us:
    type: int
    default: 1000
  recovery-clocks:
    type: int
    default: 9
  init-level:
    type: string
    default: post-kernel
  init-priority:
    type: int
    default: 20
```

## dts/bindings/yi-soft-spi.yaml
```yaml
compatible: "yi,soft-spi"
driver: "soft-spi"
header: "yi_soft_spi.h"
define: "YI_SOFT_SPI_DEFINE_LEVEL"

properties:
  sck-gpio:
    type: phandle
    required: true
  miso-gpio:
    type: phandle
    required: true
  mosi-gpio:
    type: phandle
    required: true
  max-frequency:
    type: int
    default: 100000
  mode:
    type: int
    default: 0
  init-level:
    type: string
    default: post-kernel
  init-priority:
    type: int
    default: 20
```

## dts/bindings/yi-spi.yaml
```yaml
compatible: "yi,stm32-spi"
driver: "spi"
header: "yi_spi_stm32.h"
define: "YI_SPI_STM32_DEFINE_LEVEL"

properties:
  reg:
    type: int
    required: true
  clock-bus:
    type: string
    required: true
  clock-enable-mask:
    type: int
    required: true
  interrupts:
    type: identifier
    required: true
  sck-pin:
    type: phandle
    required: true
  miso-pin:
    type: phandle
    required: true
  mosi-pin:
    type: phandle
    required: true
  max-frequency:
    type: int
    required: true
  irq-priority:
    type: int
    default: 10
  init-level:
    type: string
    default: post-kernel
  init-priority:
    type: int
    default: 20
```

## dts/bindings/yi-timer.yaml
```yaml
compatible: "yi,stm32-timer"
driver: "timer"
header: "yi_timer.h"
define: "YI_TIMER_DEFINE_LEVEL"

properties:
  reg:
    type: int
    required: true
  interrupts:
    type: identifier
    required: true
  clock-bus:
    type: string
    required: true
  clock-enable-mask:
    type: int
    required: true
  counter-bits:
    type: int
    required: true
  tick-frequency:
    type: int
    required: true
  irq-priority:
    type: int
    default: 10
  init-level:
    type: string
    default: post-kernel
  init-priority:
    type: int
    default: 10
```

## dts/bindings/yi-uart.yaml
```yaml
compatible: "yi,stm32-uart"
driver: "uart"
header: "yi_uart_stm32.h"
define: "YI_UART_STM32_DEFINE_LEVEL"

properties:
  reg:
    type: int
    required: true
  clock-bus:
    type: string
    required: true
  clock-enable-mask:
    type: int
    required: true
  interrupts:
    type: identifier
    required: true
  current-speed:
    type: int
    required: true

  tx-pin:
    type: phandle
    required: true

  rx-pin:
    type: phandle
    required: true

  irq-priority:
    type: int
    default: 10

  tx-dma-channel:
    type: identifier

  tx-dma-interrupt:
    type: identifier

  rx-dma-channel:
    type: identifier

  rx-dma-interrupt:
    type: identifier

  dma-irq-priority:
    type: int
    default: 10
```

## dts/bindings/yi-w25q64.yaml
```yaml
compatible: "winbond,w25q64"
driver: "w25q64"
header: "yi_w25q64.h"
define: "YI_W25Q64_DEFINE_LEVEL"

properties:
  bus:
    type: phandle
    required: true
  cs-gpio:
    type: phandle
    required: true
  spi-frequency:
    type: int
    required: true
  spi-mode:
    type: int
    default: 0
  size:
    type: int
    default: 8388608
  erase-block-size:
    type: int
    default: 4096
  write-block-size:
    type: int
    default: 1
  program-timeout-ms:
    type: int
    default: 100
  erase-timeout-ms:
    type: int
    default: 5000
  init-level:
    type: string
    default: post-kernel
  init-priority:
    type: int
    default: 30
```
