## Kconfig
```kconfig
# File: Kconfig
# Function: Define the root configuration menu for bare-metal YiCore builds.
# Author: Don
# Date: 2026-08-02
# Version: 1.0.0

mainmenu "YiCore Bare-Metal Configuration"

config YICORE
    bool
    default y

config BARE_METAL
    bool
    default y
    help
      Select the mandatory scheduler-free YiCore execution model.

menu "Core services"

config YI_POLL
    bool "Bare-metal poll loop"
    default y

config YI_EVENT_QUEUE
    bool "ISR-to-main event delivery"
    default y
    depends on YI_POLL

config YI_IDLE_WFI
    bool "Wait for interrupt while idle"
    default y

config LOG
    bool "Logging"
    default n
    depends on YI_POLL

config YI_SOFT_TIMER
    bool "Main-loop software timers"
    default y
    depends on YI_POLL

config ASSERT
    bool "Runtime assertions"
    default y

endmenu

menu "Device classes"

config GPIO
    bool "GPIO drivers"
    default y

config SERIAL
    bool "Serial drivers"
    default y

config SPI
    bool "SPI drivers"
    default y

config I2C
    bool "I2C drivers"
    default y

config FLASH
    bool "Flash drivers"
    default n

config TIMER
    bool "Timer drivers"
    default y

endmenu
```

## dts/bindings/adi-ad9834.yaml
```yaml
compatible: "adi,ad9834"
driver: "ad9834"
header: "yi_ad9834.h"
define: "YI_AD9834_DEFINE_LEVEL"
properties:
  bus:
    type: phandle
    required: true
  cs-gpio:
    type: phandle
    required: true
  spi-frequency:
    type: int
    default: 1000000
  mclk-frequency:
    type: int
    required: true
  transfer-timeout-ms:
    type: int
    default: 10
  init-level:
    type: string
    default: application
  init-priority:
    type: int
    default: 20
```

## dts/bindings/adi-ad9851.yaml
```yaml
compatible: "adi,ad9851"
driver: "ad9851"
header: "yi_ad9851.h"
define: "YI_AD9851_DEFINE_LEVEL"
properties:
  w-clk-gpio:
    type: phandle
    required: true
  fq-ud-gpio:
    type: phandle
    required: true
  data-gpio:
    type: phandle
    required: true
  reset-gpio:
    type: phandle
    required: true
  reference-clock-frequency:
    type: int
    required: true
  clock-multiplier:
    type: boolean
    required: false
  pulse-delay-us:
    type: int
    default: 1
  init-level:
    type: string
    default: application
  init-priority:
    type: int
    default: 20
```

## dts/bindings/guestgood-gp8210s.yaml
```yaml
compatible: "guestgood,gp8210s"
driver: "gp8210s"
header: "yi_gp8210s.h"
define: "YI_GP8210S_DEFINE_LEVEL"
properties:
  bus:
    type: phandle
    required: true
  address:
    type: int
    default: 88
  default-channel:
    type: int
    default: 0
  output-range-mv:
    type: int
    default: 5000
  channel0-value:
    type: int
    default: 0
  channel1-value:
    type: int
    default: 0
  transfer-timeout-ms:
    type: int
    default: 20
  init-level:
    type: string
    default: post-kernel
  init-priority:
    type: int
    default: 30
```

## dts/bindings/maxim-max31856.yaml
```yaml
compatible: "maxim,max31856"
driver: "max31856"
header: "yi_max31856.h"
define: "YI_MAX31856_DEFINE_LEVEL"
properties:
  bus:
    type: phandle
    required: true
  cs-gpio:
    type: phandle
    required: true
  spi-frequency:
    type: int
    default: 5000000
  thermocouple-type:
    type: string
    default: k
  filter-hz:
    type: int
    default: 50
  average-samples:
    type: int
    default: 1
  open-circuit-ms:
    type: int
    default: 100
  transfer-timeout-ms:
    type: int
    default: 10
  init-level:
    type: string
    default: application
  init-priority:
    type: int
    default: 20
```

## dts/bindings/microchip-mcp4725.yaml
```yaml
compatible: "microchip,mcp4725"
driver: "mcp4725"
header: "yi_mcp4725.h"
define: "YI_MCP4725_DEFINE_LEVEL"
properties:
  bus:
    type: phandle
    required: true
  address:
    type: int
    default: 96
  reference-mv:
    type: int
    default: 3300
  default-value:
    type: int
    default: 0
  transfer-timeout-ms:
    type: int
    default: 20
  eeprom-timeout-ms:
    type: int
    default: 100
  init-level:
    type: string
    default: post-kernel
  init-priority:
    type: int
    default: 30
```

## dts/bindings/microchip-mcp4728.yaml
```yaml
compatible: "microchip,mcp4728"
driver: "mcp4728"
header: "yi_mcp4728.h"
define: "YI_MCP4728_DEFINE_LEVEL"
properties:
  bus:
    type: phandle
    required: true
  address:
    type: int
    default: 96
  default-channel:
    type: int
    default: 0
  vdd-mv:
    type: int
    default: 3300
  transfer-timeout-ms:
    type: int
    default: 20
  eeprom-timeout-ms:
    type: int
    default: 100
  channel0-value:
    type: int
    default: 0
  channel1-value:
    type: int
    default: 0
  channel2-value:
    type: int
    default: 0
  channel3-value:
    type: int
    default: 0
  channel0-internal-reference:
    type: boolean
    default: false
  channel1-internal-reference:
    type: boolean
    default: false
  channel2-internal-reference:
    type: boolean
    default: false
  channel3-internal-reference:
    type: boolean
    default: false
  channel0-gain-2x:
    type: boolean
    default: false
  channel1-gain-2x:
    type: boolean
    default: false
  channel2-gain-2x:
    type: boolean
    default: false
  channel3-gain-2x:
    type: boolean
    default: false
  init-level:
    type: string
    default: post-kernel
  init-priority:
    type: int
    default: 30
```

## dts/bindings/te-tsys01.yaml
```yaml
compatible: "te,tsys01"
driver: "tsys01"
header: "yi_tsys01.h"
define: "YI_TSYS01_DEFINE_LEVEL"

properties:
  bus:
    type: phandle
    required: true
  address:
    type: int
    default: 119
  transfer-timeout-ms:
    type: int
    default: 20
  conversion-delay-ms:
    type: int
    default: 10
  reset-delay-ms:
    type: int
    default: 3
  validate-prom-checksum:
    type: boolean
    default: false
  init-level:
    type: string
    default: post-kernel
  init-priority:
    type: int
    default: 30
```

## dts/bindings/ti-adc081c02.yaml
```yaml
compatible: "ti,adc081c02"
driver: "adc081c02"
header: "yi_adc081c02.h"
define: "YI_ADC081C02_DEFINE_LEVEL"
properties:
  bus:
    type: phandle
    required: true
  address:
    type: int
    default: 80
  reference-mv:
    type: int
    default: 3300
  configuration:
    type: int
    default: 0
  low-limit:
    type: int
    default: 0
  high-limit:
    type: int
    default: 255
  hysteresis:
    type: int
    default: 0
  transfer-timeout-ms:
    type: int
    default: 20
  init-level:
    type: string
    default: post-kernel
  init-priority:
    type: int
    default: 30
```

## dts/bindings/ti-ads1258.yaml
```yaml
compatible: "ti,ads1258"
driver: "ads1258"
header: "yi_ads1258.h"
define: "YI_ADS1258_DEFINE_LEVEL"
properties:
  bus:
    type: phandle
    required: true
  cs-gpio:
    type: phandle
    required: true
  start-gpio:
    type: phandle
    required: true
  reset-gpio:
    type: phandle
    required: false
  drdy-gpio:
    type: phandle
    required: false
  spi-frequency:
    type: int
    default: 1000000
  transfer-timeout-ms:
    type: int
    default: 20
  config0:
    type: int
    default: 0
  config1:
    type: int
    default: 0
  muxsch:
    type: int
    default: 0
  muxdif:
    type: int
    default: 0
  single-ended-mask:
    type: int
    default: 65535
  system-readings:
    type: int
    default: 0
  init-level:
    type: string
    default: post-kernel
  init-priority:
    type: int
    default: 30
```

## dts/bindings/ti-ads1298.yaml
```yaml
compatible: "ti,ads1298"
driver: "ads1298"
header: "yi_ads1298.h"
define: "YI_ADS1298_DEFINE_LEVEL"
properties:
  bus:
    type: phandle
    required: true
  cs-gpio:
    type: phandle
    required: true
  enable-gpio:
    type: phandle
    required: false
  enable-active-low:
    type: boolean
    default: false
  reset-gpio:
    type: phandle
    required: false
  start-gpio:
    type: phandle
    required: false
  drdy-gpio:
    type: phandle
    required: false
  spi-frequency:
    type: int
    default: 1000000
  master-clock-hz:
    type: int
    default: 2048000
  transfer-timeout-ms:
    type: int
    default: 20
  data-rate:
    type: int
    default: 6
  high-resolution:
    type: boolean
    default: true
  internal-reference:
    type: boolean
    default: true
  reference-4v:
    type: boolean
    default: false
  config2:
    type: int
    default: 64
  config3-extra:
    type: int
    default: 0
  loff:
    type: int
    default: 0
  rld-sensp:
    type: int
    default: 0
  rld-sensn:
    type: int
    default: 0
  loff-sensp:
    type: int
    default: 0
  loff-sensn:
    type: int
    default: 0
  loff-flip:
    type: int
    default: 0
  gpio-register:
    type: int
    default: 0
  pace:
    type: int
    default: 0
  resp:
    type: int
    default: 0
  config4:
    type: int
    default: 0
  wct1:
    type: int
    default: 0
  wct2:
    type: int
    default: 0
  channel-power-down-mask:
    type: int
    default: 0
  channel0-gain:
    type: int
    default: 6
  channel1-gain:
    type: int
    default: 6
  channel2-gain:
    type: int
    default: 6
  channel3-gain:
    type: int
    default: 6
  channel4-gain:
    type: int
    default: 6
  channel5-gain:
    type: int
    default: 6
  channel6-gain:
    type: int
    default: 6
  channel7-gain:
    type: int
    default: 6
  channel0-mux:
    type: string
    default: normal
  channel1-mux:
    type: string
    default: normal
  channel2-mux:
    type: string
    default: normal
  channel3-mux:
    type: string
    default: normal
  channel4-mux:
    type: string
    default: normal
  channel5-mux:
    type: string
    default: normal
  channel6-mux:
    type: string
    default: normal
  channel7-mux:
    type: string
    default: normal
  init-level:
    type: string
    default: post-kernel
  init-priority:
    type: int
    default: 30
```

## dts/bindings/ti-ads7830.yaml
```yaml
compatible: "ti,ads7830"
driver: "ads7830"
header: "yi_ads7830.h"
define: "YI_ADS7830_DEFINE_LEVEL"

properties:
  bus:
    type: phandle
    required: true
  address:
    type: int
    default: 72
  default-channel:
    type: int
    default: 0
  internal-reference:
    type: boolean
    default: false
  reference-mv:
    type: int
    default: 3300
  transfer-timeout-ms:
    type: int
    default: 20
  init-level:
    type: string
    default: post-kernel
  init-priority:
    type: int
    default: 30
```

## dts/bindings/ti-ads8688.yaml
```yaml
compatible: "ti,ads8688"
driver: "ads8688"
header: "yi_ads8688.h"
define: "YI_ADS8688_DEFINE_LEVEL"
properties:
  bus:
    type: phandle
    required: true
  cs-gpio:
    type: phandle
    required: true
  spi-frequency:
    type: int
    default: 1000000
  transfer-timeout-ms:
    type: int
    default: 20
  default-channel:
    type: int
    default: 0
  auto-sequence-mask:
    type: int
    default: 255
  power-down-mask:
    type: int
    default: 0
  channel0-range:
    type: int
    default: 0
  channel1-range:
    type: int
    default: 0
  channel2-range:
    type: int
    default: 0
  channel3-range:
    type: int
    default: 0
  channel4-range:
    type: int
    default: 0
  channel5-range:
    type: int
    default: 0
  channel6-range:
    type: int
    default: 0
  channel7-range:
    type: int
    default: 0
  init-level:
    type: string
    default: post-kernel
  init-priority:
    type: int
    default: 30
```

## dts/bindings/yi-adc.yaml
```yaml
compatible: "yi,stm32f1-adc"
driver: "adc"
header: "yi_adc_stm32f1.h"
define: "YI_ADC_STM32F1_DEFINE_LEVEL"

properties:
  reg:
    type: int
    required: true
  clock-bus:
    type: string
    required: true
  clock-enable-mask:
    type: int
    required: true
  input-pin:
    type: phandle
    required: true
  channel:
    type: int
    required: true
  sample-cycles:
    type: int
    default: 7
  clock-divider:
    type: int
    default: 6
  init-level:
    type: string
    default: post-kernel
  init-priority:
    type: int
    default: 20
```

## dts/bindings/yi-wch-gpio.yaml
```yaml
compatible: "yi,wch-gpio"
driver: "gpio"
header: "yi_gpio.h"
define: "YI_GPIO_DEFINE_LEVEL"

properties:
  port:
    type: identifier
    required: true
  pin:
    type: int
    required: true
  direction:
    type: string
    default: output
  drive:
    type: string
    default: push-pull
  pull:
    type: string
    default: none
  interrupt:
    type: string
    default: none
  irq-priority:
    type: int
    default: 10
  init-level:
    type: string
    default: pre-kernel
  init-priority:
    type: int
    default: 50
```

## dts/bindings/yi-wch-uart.yaml
```yaml
compatible: "yi,wch-uart"
driver: "uart"
header: "yi_uart_wch.h"
define: "YI_UART_WCH_DEFINE_LEVEL"

properties:
  reg:
    type: int
    required: true
  current-speed:
    type: int
    required: true
  tx-port:
    type: identifier
    required: true
  tx-pin:
    type: int
    required: true
  rx-port:
    type: identifier
    required: true
  rx-pin:
    type: int
    required: true
  alternate:
    type: int
    required: true
  interrupts:
    type: identifier
    required: true
  irq-priority:
    type: int
    default: 10
```
