/*
 * File: board-devices.dtsi
 * Description: Define the Yi STM32F407 bootstrap LED device.
 * Author: Don
 * Date: 2026-07-31
 * Version: 1.0.0
 */

led0: led0 {
    compatible = "yi,gpio-led";
    gpios = <&led0_gpio>;
    active-low;
    init-level = "application";
    init-priority = <10>;
    status = "available";
};
