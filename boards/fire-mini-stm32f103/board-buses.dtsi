    soft_i2c0: soft-i2c0 {
        compatible = "yi,soft-i2c";
        scl-gpio = <&soft_i2c0_scl>;
        sda-gpio = <&soft_i2c0_sda>;
        clock-frequency = <50000>;
        stretch-timeout-us = <1000>;
        recovery-clocks = <9>;
        init-level = "post-kernel";
        init-priority = <20>;
        status = "disabled";
    };
