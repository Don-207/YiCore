/include/ "../../boards/ECG-Board/board.dts"
/include/ "app-gpios.dtsi"
/include/ "app-pinctrl.dtsi"
/include/ "app-devices.dtsi"

/*
 * Application device selection.
 *
 * The selected board supplies all available labels. Enable only labels that
 * exist in that board; keep board-independent parameter overrides in the
 * application-local .dtsi files above.
 */

&console0 {
    status = "okay";
};

&led0 {
    status = "okay";
};

&usart1 {
    status = "okay";
};

&ads1298 {
    status = "okay";
};
